img0start:
    DATA 0x1299, 0x20
    DATA 0x1299, 0x20
    DATA 0x0, 0x0
    DATA 0x1209, 0x20
    DATA 0x1209, 0x20
    DATA 0x0, 0x0
    DATA 0x1299, 0x20
    DATA 0x1299, 0x20
    DATA 0x0, 0x0
    DATA 0x22ff, 0x2e
    DATA 0x22ff, 0x2e
    DATA 0x0, 0x0
    DATA 0x299, 0x20
    DATA 0x299, 0x20
    DATA 0x200, 0x20
    DATA 0x200, 0x20
    DATA 0x0, 0x0
    DATA 0x0, 0x0
    DATA 0x0, 0x0
    DATA 0x0, 0x0
    DATA 0x0, 0x0
img0end:
img1start:
    DATA 0x80, 0x6
    DATA 0x70, 0xe0
    DATA 0x70, 0xe0
    DATA 0x3f8f, 0xfe
    DATA 0x0, 0xe0
    DATA 0x0, 0x0
    DATA 0x0, 0x0
    DATA 0x3fff, 0xfe
    DATA 0x80, 0x6
    DATA 0xe, 0x0
    DATA 0x2001, 0x8
    DATA 0xe, 0x0
    DATA 0x80, 0x6
    DATA 0x3fff, 0xfe
    DATA 0x0, 0x0
    DATA 0x0, 0x0
    DATA 0x3f8f, 0xfe
    DATA 0x70, 0x0
    DATA 0x70, 0x0
    DATA 0x70, 0x0
    DATA 0x3f8f, 0xfe
    DATA 0x0, 0x0
    DATA 0x0, 0x0
    DATA 0x0, 0x0
    DATA 0x0, 0x0
    DATA 0x0, 0x0
    DATA 0x0, 0x0
    DATA 0x0, 0x0
    DATA 0x0, 0x0
    DATA 0x0, 0x0
    DATA 0x0, 0x0
    DATA 0x0, 0x0
    DATA 0x0, 0x0
    DATA 0x0, 0x0
    DATA 0x0, 0x0
    DATA 0x0, 0x0
    DATA 0x0, 0x0
    DATA 0x0, 0x0
    DATA 0x0, 0x0
    DATA 0x0, 0x0
    DATA 0x0, 0x0
    DATA 0x0, 0x0
    DATA 0x0, 0x0
    DATA 0x0, 0x0
    DATA 0x0, 0x0
    DATA 0x0, 0x0
    DATA 0x0, 0x0
    DATA 0x0, 0x0
    DATA 0x0, 0x0
img1end:
img2start:
    DATA 0xd4e, 0xdc
    DATA 0xdce, 0xde
    DATA 0x36cf, 0xb6
    DATA 0x16ce, 0xde
    DATA 0x154e, 0xdc
    DATA 0xd44, 0xdc
    DATA 0xd44, 0xdc
    DATA 0xdc4, 0xde
    DATA 0xdf4, 0xde
    DATA 0x12f9, 0xc6
    DATA 0x11f5, 0xd6
    DATA 0xdc5, 0xd6
    DATA 0xd44, 0xdc
    DATA 0xd44, 0xdc
    DATA 0xd44, 0xdc
    DATA 0xd44, 0xdc
    DATA 0x3d45, 0xdc
    DATA 0x3d45, 0xdc
    DATA 0x2d45, 0xdc
    DATA 0x2d45, 0xdc
    DATA 0x3d45, 0xdc
    DATA 0x3f45, 0xdc
    DATA 0x3d45, 0xdc
    DATA 0x2d45, 0xdc
    DATA 0x2d45, 0xdc
    DATA 0x3d45, 0xdc
    DATA 0x3d45, 0xdc
    DATA 0xd44, 0xdc
    DATA 0xd44, 0xdc
    DATA 0xd44, 0xdc
    DATA 0xd44, 0xdc
    DATA 0x3f45, 0xfc
    DATA 0x3f45, 0xfc
    DATA 0xd44, 0xdc
    DATA 0xd44, 0xdc
    DATA 0xd44, 0xdc
    DATA 0xd44, 0xdc
    DATA 0x3d45, 0xdc
    DATA 0x1345, 0xc4
    DATA 0x3e45, 0xcc
    DATA 0x1b45, 0xc4
    DATA 0x1344, 0x6c
    DATA 0xd44, 0xdc
    DATA 0xd44, 0xdc
    DATA 0xd44, 0xdc
    DATA 0xd44, 0xdc
    DATA 0xd44, 0xdc
    DATA 0xd44, 0xdc
    DATA 0xd44, 0xdc
    DATA 0xd44, 0xdc
    DATA 0xd44, 0xdc
    DATA 0xd44, 0xdc
    DATA 0xd44, 0xdc
img2end:
img3start:
    DATA 0x904, 0xa
    DATA 0x924, 0x4a
    DATA 0x120, 0x42
    DATA 0x120, 0x42
    DATA 0x120, 0x42
    DATA 0x0, 0x0
    DATA 0x0, 0x0
    DATA 0x924, 0x4a
    DATA 0x924, 0x4a
    DATA 0x104, 0x48
    DATA 0x904, 0x48
    DATA 0x900, 0x8
    DATA 0x0, 0x0
    DATA 0x0, 0x0
    DATA 0x904, 0x4a
    DATA 0x924, 0x4a
    DATA 0x20, 0x2
    DATA 0x4, 0xa
    DATA 0x4, 0xa
    DATA 0x20, 0x2
    DATA 0x924, 0x4a
    DATA 0x904, 0x4a
    DATA 0x0, 0x0
    DATA 0x0, 0x0
    DATA 0x0, 0x0
    DATA 0x0, 0x0
    DATA 0x0, 0x0
    DATA 0x0, 0x90
    DATA 0x0, 0x90
    DATA 0x0, 0x0
    DATA 0x0, 0x0
    DATA 0x2442, 0x94
    DATA 0x2442, 0x94
    DATA 0x0, 0x0
    DATA 0x0, 0x0
    DATA 0x2402, 0x14
    DATA 0x2442, 0x94
    DATA 0x40, 0x94
    DATA 0x40, 0x94
    DATA 0x2442, 0x94
    DATA 0x2402, 0x14
    DATA 0x0, 0x0
    DATA 0x0, 0x0
    DATA 0x0, 0x0
    DATA 0x0, 0x0
    DATA 0x0, 0x0
img3end:
img4start:
    DATA 0x0, 0x0
    DATA 0x0, 0x0
    DATA 0x1c70, 0x0
    DATA 0x3cff, 0xe
    DATA 0x1f70, 0x10
    DATA 0x3fff, 0xfe
    DATA 0x1f70, 0xf0
    DATA 0x3fff, 0xfe
    DATA 0x1f70, 0x10
    DATA 0x3cff, 0xe
    DATA 0x1c70, 0x0
    DATA 0x0, 0x0
    DATA 0x0, 0x0
    DATA 0x0, 0x0
    DATA 0x0, 0x0
    DATA 0x0, 0x0
    DATA 0x0, 0x0
    DATA 0x0, 0x0
    DATA 0x0, 0x0
    DATA 0x0, 0x0
img4end:
img5start:
    DATA 0x0, 0x0
    DATA 0x1289, 0x0
    DATA 0x281, 0x0
    DATA 0x280, 0x0
    DATA 0x0, 0x0
    DATA 0x0, 0x0
    DATA 0x0, 0x0
    DATA 0x31, 0x8
    DATA 0x1881, 0xa
    DATA 0x30d, 0x8
    DATA 0x1, 0x68
    DATA 0x0, 0x0
    DATA 0x0, 0x0
    DATA 0x0, 0x0
    DATA 0x1289, 0x0
    DATA 0x280, 0x0
    DATA 0x280, 0x0
    DATA 0x0, 0x0
    DATA 0x0, 0x0
    DATA 0x0, 0x0
    DATA 0x0, 0x0
    DATA 0x0, 0x0
    DATA 0x0, 0x0
    DATA 0x0, 0x0
    DATA 0x0, 0x0
    DATA 0x0, 0x0
    DATA 0x0, 0x0
    DATA 0x0, 0x0
    DATA 0x0, 0x0
    DATA 0x0, 0x0
    DATA 0x0, 0x0
    DATA 0x0, 0x0
    DATA 0x0, 0x0
    DATA 0x0, 0x0
    DATA 0x0, 0x0
img5end:
img6start:
    DATA 0x800, 0xc0
    DATA 0x100, 0x0
    DATA 0x2c00, 0x48
    DATA 0x2006, 0x48
    DATA 0x1000, 0x46
    DATA 0x16c, 0x0
    DATA 0x860, 0x8
    DATA 0x64, 0x8
    DATA 0x0, 0x6
    DATA 0x2026, 0x8
    DATA 0x2c20, 0x8
    DATA 0x12a, 0x10
    DATA 0x400, 0xc2
    DATA 0x4, 0xc8
    DATA 0x800, 0xc0
    DATA 0x100, 0x0
    DATA 0x2c00, 0x48
    DATA 0x2006, 0x48
    DATA 0x1800, 0x46
    DATA 0x162, 0x0
    DATA 0x860, 0x8
    DATA 0x64, 0x8
    DATA 0x0, 0x6
    DATA 0x2026, 0x8
    DATA 0x2c20, 0x8
    DATA 0x128, 0x10
    DATA 0x1400, 0xc2
    DATA 0x4, 0xc8
img6end:
img7start:
    DATA 0x0, 0x0
    DATA 0x80, 0x6
    DATA 0x2071, 0x8
    DATA 0x1c7e, 0x0
    DATA 0x1c7e, 0x0
    DATA 0x1c7e, 0x0
    DATA 0x37e, 0x10
    DATA 0x380, 0x6
    DATA 0x300, 0x0
    DATA 0x500, 0x10
    DATA 0x500, 0x10
    DATA 0x500, 0x10
    DATA 0x2c00, 0x10
    DATA 0x2d02, 0x98
    DATA 0x2c02, 0x10
    DATA 0x2c02, 0xc
    DATA 0x2446, 0xe
    DATA 0x2046, 0x4
    DATA 0x2062, 0x6
    DATA 0x40, 0x6
    DATA 0x46, 0x4
    DATA 0x40, 0x4
    DATA 0x40, 0x0
    DATA 0x0, 0x0
    DATA 0x0, 0x0
    DATA 0x0, 0x0
    DATA 0x0, 0x0
    DATA 0x0, 0x0
    DATA 0x0, 0x0
    DATA 0x0, 0x0
    DATA 0x0, 0x0
    DATA 0x0, 0x0
    DATA 0x0, 0x0
    DATA 0x0, 0x0
    DATA 0x0, 0x0
    DATA 0x0, 0x0
    DATA 0x0, 0x0
    DATA 0x0, 0x0
    DATA 0x0, 0x0
    DATA 0x0, 0x0
    DATA 0x0, 0x0
    DATA 0x0, 0x0
img7end:
img8start:
    DATA 0x2, 0x0
    DATA 0x2000, 0x0
    DATA 0x4, 0xa
    DATA 0x944, 0x4a
    DATA 0x544, 0xc
    DATA 0x904, 0xa
    DATA 0x544, 0x4c
    DATA 0x944, 0x4a
    DATA 0x4, 0xa
    DATA 0x400, 0x0
    DATA 0x400, 0x10
    DATA 0x400, 0x0
    DATA 0x0, 0x0
    DATA 0x0, 0x0
    DATA 0x0, 0x0
    DATA 0x0, 0x0
    DATA 0x0, 0x0
    DATA 0x0, 0x0
    DATA 0x0, 0x0
    DATA 0x0, 0x0
img8end:
img9start:
    DATA 0x2000, 0x0
    DATA 0x2402, 0x0
    DATA 0x3282, 0x6
    DATA 0x12ff, 0x26
    DATA 0x128d, 0xe
    DATA 0x180d, 0x8
    DATA 0x1, 0x8
    DATA 0x0, 0x0
    DATA 0x0, 0x0
    DATA 0x0, 0x0
    DATA 0x0, 0x0
    DATA 0x0, 0x0
    DATA 0x0, 0x0
img9end:
img10start:
    DATA 0x2, 0x84
    DATA 0x2000, 0x10
    DATA 0x2440, 0x84
    DATA 0x2002, 0x0
    DATA 0x2542, 0x14
    DATA 0x2002, 0x0
    DATA 0x2542, 0x14
    DATA 0x2002, 0x0
    DATA 0x2440, 0x84
    DATA 0x2000, 0x10
    DATA 0x2, 0x84
    DATA 0x0, 0x0
    DATA 0x0, 0x0
    DATA 0x0, 0x0
    DATA 0x0, 0x0
    DATA 0x0, 0x0
    DATA 0x0, 0x0
    DATA 0x0, 0x0
    DATA 0x0, 0x0
    DATA 0x0, 0x0
    DATA 0x0, 0x0
    DATA 0x0, 0x0
    DATA 0x0, 0x0
    DATA 0x0, 0x0
    DATA 0x0, 0x0
    DATA 0x0, 0x0
    DATA 0x0, 0x0
    DATA 0x0, 0x0
img10end:
img11start:
    DATA 0x0, 0x40
    DATA 0x0, 0x40
    DATA 0x924, 0x4a
    DATA 0x0, 0x40
    DATA 0x0, 0x40
    DATA 0x0, 0x0
    DATA 0x0, 0x0
    DATA 0x924, 0x4a
    DATA 0x20, 0x40
    DATA 0x20, 0x40
    DATA 0x924, 0x4a
    DATA 0x0, 0x0
    DATA 0x0, 0x0
    DATA 0x924, 0x4a
    DATA 0x20, 0x40
    DATA 0x20, 0x40
    DATA 0x924, 0x4a
    DATA 0x0, 0x0
    DATA 0x0, 0x0
    DATA 0x924, 0x4a
    DATA 0x20, 0x0
    DATA 0x20, 0x0
    DATA 0x20, 0x0
    DATA 0x0, 0x0
    DATA 0x0, 0x0
    DATA 0x0, 0x0
    DATA 0x0, 0x0
    DATA 0x0, 0x0
    DATA 0x0, 0x0
    DATA 0x0, 0x0
    DATA 0x0, 0x0
    DATA 0x0, 0x0
    DATA 0x0, 0x0
    DATA 0x0, 0x0
    DATA 0x1bbd, 0x6a
    DATA 0x1, 0x68
    DATA 0x1, 0x68
    DATA 0x1b01, 0x68
    DATA 0x0, 0x0
    DATA 0x0, 0x0
    DATA 0x1bbd, 0x6a
    DATA 0x30, 0x0
    DATA 0x30, 0x0
    DATA 0x1bbd, 0x6a
    DATA 0x0, 0x0
    DATA 0x0, 0x0
    DATA 0x1bbd, 0x6a
    DATA 0x1b00, 0x0
    DATA 0x180d, 0x8
    DATA 0x8c, 0x2
    DATA 0x1bbd, 0x6a
    DATA 0x0, 0x0
    DATA 0x0, 0x0
    DATA 0x0, 0x60
    DATA 0x0, 0x60
    DATA 0x1bbd, 0x6a
    DATA 0x0, 0x60
    DATA 0x0, 0x60
    DATA 0x0, 0x0
    DATA 0x0, 0x0
    DATA 0x0, 0x0
    DATA 0x0, 0x0
    DATA 0x0, 0x0
    DATA 0x0, 0x0
    DATA 0x0, 0x0
    DATA 0x0, 0x0
    DATA 0x0, 0x0
    DATA 0x0, 0x0
    DATA 0x0, 0x0
    DATA 0x1299, 0x20
    DATA 0x1, 0x0
    DATA 0x1, 0x0
    DATA 0x1299, 0x20
    DATA 0x0, 0x0
    DATA 0x0, 0x0
    DATA 0x1299, 0x20
    DATA 0x8, 0x20
    DATA 0x8, 0x20
    DATA 0x1299, 0x20
    DATA 0x0, 0x0
    DATA 0x0, 0x0
    DATA 0x1299, 0x20
    DATA 0x10, 0x20
    DATA 0x10, 0x20
    DATA 0x10, 0x20
    DATA 0x0, 0x0
    DATA 0x0, 0x0
    DATA 0x1299, 0x20
    DATA 0x1, 0x0
    DATA 0x1008, 0x0
    DATA 0x290, 0x20
    DATA 0x0, 0x0
    DATA 0x0, 0x0
    DATA 0x0, 0x0
    DATA 0x0, 0x0
    DATA 0x0, 0x0
    DATA 0x0, 0x0
    DATA 0x0, 0x0
    DATA 0x0, 0x0
    DATA 0x0, 0x0
img11end:
img12start:
    DATA 0x0, 0x0
    DATA 0x30, 0x0
    DATA 0xb0, 0x2
    DATA 0xbc, 0x2
    DATA 0xbc, 0x2
    DATA 0xb1, 0xa
    DATA 0x1831, 0x8
    DATA 0x1b01, 0x8
    DATA 0x1b01, 0x8
    DATA 0x1831, 0x8
    DATA 0xb1, 0xa
    DATA 0xbc, 0x2
    DATA 0xbc, 0x2
    DATA 0xb0, 0x2
    DATA 0x30, 0x0
    DATA 0x0, 0x0
    DATA 0x0, 0x0
    DATA 0x0, 0x0
    DATA 0x0, 0x0
    DATA 0x0, 0x0
img12end:
img13start:
    DATA 0x0, 0x0
    DATA 0x0, 0x0
    DATA 0x0, 0x0
    DATA 0x0, 0x0
    DATA 0x0, 0x0
    DATA 0x0, 0x0
    DATA 0x0, 0x0
    DATA 0x0, 0x0
    DATA 0x0, 0x0
    DATA 0x0, 0x0
    DATA 0x0, 0x0
    DATA 0x0, 0x0
    DATA 0x0, 0x0
    DATA 0x0, 0x0
    DATA 0x0, 0x0
    DATA 0x0, 0x0
    DATA 0x0, 0x0
    DATA 0x0, 0x0
    DATA 0x0, 0x0
    DATA 0x0, 0x0
    DATA 0x0, 0x0
    DATA 0x0, 0x0
img13end:
images:
    DW img0start
    DW img0end
    DW img1start
    DW img1end
    DW img2start
    DW img2end
    DW img3start
    DW img3end
    DW img4start
    DW img4end
    DW img5start
    DW img5end
    DW img6start
    DW img6end
    DW img7start
    DW img7end
    DW img8start
    DW img8end
    DW img9start
    DW img9end
    DW img10start
    DW img10end
    DW img11start
    DW img11end
    DW img12start
    DW img12end
    DW img13start
    DW img13end
imgcnt equ 0xe
